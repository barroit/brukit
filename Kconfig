## Kconfig
```kconfig
# SPDX-License-Identifier: GPL-3.0-or-later or MIT

source "lib/Kconfig.include"

mainmenu "$(pg-name)/$(pg-build)-$(pg-arch) $(pg-version) Configuration"

source "lib/Kconfig.build"

source "lib/Kconfig.feature"

source "lib/Kconfig.debug"
```

## lib/Kconfig.build
```kconfig
# SPDX-License-Identifier: GPL-3.0-or-later or MIT

menu "Build options"

choice
	prompt "Compiler optimization level"
	default CC_OPTIMIZE_NONE if DEBUG_PROG
	default CC_OPTIMIZE_PERF

config CC_OPTIMIZE_NONE
	bool "Disable optimization (-O0)"

config CC_OPTIMIZE_PERF
	bool "Optimize for performance (-O2)"

config CC_OPTIMIZE_O3
	bool "Further optimizing performance (-O3)"

endchoice

config ARCH_SPEC
	bool "Add arch-specific code"
	depends on $(exist,arch/.map)

menuconfig SPEC_EXEC_NAME
	bool "Customize executable name"
	default y

if SPEC_EXEC_NAME

config EXEC_NAME
	string "Executable name"
	default $(lower,$(pg-name))

endif

config WIN_GUI
	bool "Build program with gui"
	depends on $(WIN32)

config WIDE_CHAR
	bool "Use wide character"
	default y
	depends on $(WIN32)

menu "Memory allocation"

config PANIC_NOMEM
	bool "Abort execution when memory allocation fails"
	default DEBUG_PROG
	help
	  This is unlikely to happen on modern systems, as running out
	  of memory is rare in most cases.

config WARN_HUGE_ALLOC
	bool "Warn when allocating a large amount of memory"
	default PANIC_NOMEM
	depends on PANIC_NOMEM

endmenu # Memory allocation

config ENABLE_TESTING
	bool "Generate test suite"

endmenu # Executable build options
```

## lib/Kconfig.debug
```kconfig
# SPDX-License-Identifier: GPL-3.0-or-later or MIT

menu "Hacking"

config ENABLE_DEBUG
	bool "Debug program"

config DEBUG_INFO
	bool

choice
	prompt "Debug information"
	depends on ENABLE_DEBUG
	default DEBUG_INFO_DWARF5 if CC_IS_GCC || \
				     (CC_IS_CLANG && CC_VERSION > 11000)
	default DEBUG_INFO_DWARF4

config DEBUG_INFO_NONE
	bool "Disable debug information"

config DEBUG_INFO_DWARF4
	bool "Generate DWARF Version 4 debug information"
	select DEBUG_INFO

config DEBUG_INFO_DWARF5
	bool "Generate DWARF Version 5 debug information"
	select DEBUG_INFO

endchoice # Debug information

choice
	prompt "Compressed debug information"
	depends on DEBUG_INFO

config DEBUG_INFO_COMPRESSED_NONE
	bool "Don't compress debug information"

config DEBUG_INFO_COMPRESSED_ZLIB
	bool "Compress debugging information with zlib"
	depends on $(cc-option,-gz=zlib)
	depends on $(ld-option,--compress-debug-sections=zlib)

config DEBUG_INFO_COMPRESSED_ZSTD
	bool "Compress debugging information with zstd"
	depends on $(cc-option,-gz=zstd)
	depends on $(ld-option,--compress-debug-sections=zstd)

endchoice # Compressed Debug information

config ENABLE_SANITIZER
	bool "Build program with sanitizers"
	select IGNORE_ANNOT_LEAKS
	default ENABLE_DEBUG

config DUMP_COMPILE_COMMAND
	bool "Dump compile command"
	default ENABLE_DEBUG

config DEBUG_INTL
	bool "Link with the non-inline function call version of intl"
	depends on ENABLE_I18N

menu "List options"

config LIST_SANITIZE_MODIFICATION
	bool "Validate list modification"
	default ENABLE_DEBUG

endmenu # List options

endmenu # Hacking
```

## lib/Kconfig.feat
```kconfig
# SPDX-License-Identifier: GPL-3.0-or-later or MIT

menu "Core features"

config I18N_SUPP
	bool "Enable i18n support"

config WIDE_CHAR
	bool "Use wide character"
	default y
	depends on $(WIN32)

config TERMAS_SMALL_BUFFER
	bool "Use small (1K) buffer in termas report functions"

config TS_SMALL_UNIT
	bool "Display timestamps in milliseconds"

menuconfig SPEC_ALT_CNTRL
	bool "Customize control character replacement"
	default y

if SPEC_ALT_CNTRL

config ALT_CNTRL
	string "Control character replacement"
	default "�"

endif

endmenu # Program features
```

## lib/Kconfig.include
```kconfig
# SPDX-License-Identifier: GPL-3.0-or-later or MIT

comma  := ,

# I do this my way
$(warn-off)

# check if $(CC) and $(LD) exist
$(error-if,$(failure,$(CC) -v),C compiler '$(CC)' not found)
$(error-if,$(failure,$(LD) -v),linker '$(LD)' not found)

pg_info    := $(pg-info)
pg-name    := $(word,$(pg_info),1)
pg-version := $(word,$(pg_info),2)
pg-arch    := $(word,$(pg_info),3)
pg-build   := $(word,$(pg_info),4)

cc_info    := $(cc-info)
$(error-if,$(empty,$(cc_info)),compiler '$(CC)' is not supported)

cc-name    := $(word,$(cc_info),1)
cc-version := $(word,$(cc_info),2)

cc-minver  := $(word,$(cc_info),3)
$(error-if,$(less,$(cc-version),$(cc-minver)),compiler '$(CC)' is too old)

ld_info    := $(ld-info)
$(error-if,$(empty,$(ld_info)),linker '$(LD)' is not supported)

ld-name    := $(word,$(ld_info),1)
ld-version := $(word,$(ld_info),2)

# check if $(CC) is not too old

config PROG_NAME
	def_string $(pg-name)

config PROG_VERSION
	def_string $(pg-version)

config PROG_ARCH
	def_string $(pg-arch)

config PROG_BUILD
	def_string $(pg-build)

config CC_NAME
	def_string $(cc-name)

config CC_COMMAND
	def_string $(CC)

config CC_VERSION
	def_int $(cc-version)

config LD_NAME
	def_string $(ld-name)

config LD_COMMAND
	def_string $(LD)

config LD_VERSION
	def_int $(ld-version)

config CC_IS_CLNAG
	def_bool CC_NAME = "Clang"

config CC_IS_GCC
	def_bool CC_NAME = "GCC"
```

## lib/Kconfig.init
```kconfig
# SPDX-License-Identifier: GPL-3.0-or-later or MIT

comma  := ,

# I do this my way
$(warn-off)

# check if .program exists
$(error-if,$(not-exist,.program),.program not found$(comma) `make init.sh`?)

# check if $(CC) and $(LD) exist
$(error-if,$(failure,$(CC) -v),C compiler '$(CC)' not found)
$(error-if,$(failure,$(LD) -v),linker '$(LD)' not found)

pg_info    := $(pg-info)
pg-name    := $(word,$(pg_info),1)
pg-version := $(word,$(pg_info),2)
pg-arch    := $(word,$(pg_info),3)
pg-build   := $(word,$(pg_info),4)

cc_info    := $(cc-info)
cc-name    := $(word,$(cc_info),1)
cc-version := $(word,$(cc_info),2)
cc-minver  := $(word,$(cc_info),3)

ld_info    := $(ld-info)
ld-name    := $(word,$(ld_info),1)
ld-version := $(word,$(ld_info),2)

# check if $(CC) is not too old
$(error-if,$(less,$(cc-version),$(cc-minver)),\
C compiler '$(CC)' is too old (min v$(to-sver,$(cc-minver))))

config PROG_NAME
	def_string $(pg-name)

config PROG_VERSION
	def_string $(pg-version)

config PROG_ARCH
	def_string $(pg-arch)

config PROG_BUILD
	def_string $(pg-build)

config CC_NAME
	def_string $(cc-name)

config CC_VERSION
	def_int $(cc-version)

config LD_NAME
	def_string $(ld-name)

config LD_VERSION
	def_int $(ld-version)

config CC_IS_CLNAG
	def_bool CC_NAME = "Clang"

config CC_IS_GCC
	def_bool CC_NAME = "GCC"

menu "General setup"

choice
	prompt "Compiler optimization level"
	default CC_OPTIMIZE_SIZE if DEBUG_PROG
	default CC_OPTIMIZE_PERF

config CC_OPTIMIZE_PERF
	bool "Optimize for performance (-O2)"

config CC_OPTIMIZE_SIZE
	bool "Optimize for size (-Os)"

config CC_OPTIMIZE_O3
	bool "Further optimizing performance (-O3)"

endchoice

config I18N_SUPP
	bool "Enable i18n support"

config ARCH_SPEC
	bool "Add arch-specific code"
	depends on $(exist,arch/.map)

config WIN_GUI
	bool "Build program with gui"
	depends on $(is-win32)

config WIN_GUI

endmenu # General setup
```
